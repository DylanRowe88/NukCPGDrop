## firmware/main/Kconfig
```kconfig
menu "Board Configuration"

choice BOARD_SELECTION
    prompt "Target board"
    default BOARD_DISPLAY

config BOARD_DISPLAY
    bool "2.8inch ESP32-S3 Display (N16R8)"

config BOARD_DEVKITC
    bool "ESP32-S3-DevKitC (N8R2)"

endchoice

config I2C_SDA_GPIO
    int
    default 16 if BOARD_DISPLAY
    default 8  if BOARD_DEVKITC

config I2C_SCL_GPIO
    int
    default 15 if BOARD_DISPLAY
    default 9  if BOARD_DEVKITC

config LED_GPIO
    int
    default 42 if BOARD_DISPLAY
    default 48 if BOARD_DEVKITC

endmenu
```

## firmware/sdkconfig.defaults
```kconfig
CONFIG_IDF_TARGET="esp32s3"
CONFIG_IDF_TARGET_ESP32S3=y

CONFIG_ESPTOOLPY_FLASHSIZE_16MB=y
CONFIG_ESPTOOLPY_FLASHSIZE="16MB"
CONFIG_PARTITION_TABLE_CUSTOM=y
CONFIG_PARTITION_TABLE_CUSTOM_FILENAME="partitions.csv"

CONFIG_FREERTOS_HZ=1000

CONFIG_I2C_USE_DMA=y

CONFIG_ESP_WIFI_SOFTAP_SUPPORT=y
CONFIG_LWIP_DNS_CHECK_DOMAINS_REVERSE=n

CONFIG_COMPILER_OPTIMIZATION_DEBUG=y
CONFIG_COMPILER_OPTIMIZATION_ASSERTIONS_ENABLE=y

CONFIG_ESP_SYSTEM_PANIC_PRINT_HALT=y

# Octal PSRAM — required by the 2.8" Display board
CONFIG_SPIRAM=y
CONFIG_SPIRAM_MODE_OCT=y
CONFIG_SPIRAM_SPEED_80M=y
CONFIG_SPIRAM_FETCH_INSTRUCTIONS=y
CONFIG_SPIRAM_RODATA=y
CONFIG_SPIRAM_CLK_IO=30
CONFIG_SPIRAM_CS_IO=26
CONFIG_SPIRAM_IGNORE_NOTFOUND=y

# USB-serial-JTAG console (board has no external UART bridge)
CONFIG_ESP_CONSOLE_USB_SERIAL_JTAG=y

# Larger main task stack for LVGL
CONFIG_ESP_MAIN_TASK_STACK_SIZE=8192

# Board selection: Display board by default
CONFIG_BOARD_DISPLAY=y

# LVGL config
CONFIG_LV_TFT_DISPLAY_CONTROLLER_ILI9341=y
CONFIG_LV_TFT_DISPLAY_PROTOCOL_SPI=y
CONFIG_LV_DISP_SPI_MOSI=11
CONFIG_LV_DISP_SPI_MISO=13
CONFIG_LV_DISP_SPI_CLK=12
CONFIG_LV_DISP_SPI_CS=10
CONFIG_LV_DISP_PIN_DC=46
CONFIG_LV_DISP_USE_RST=n
CONFIG_LV_DISP_PIN_RST=-1
CONFIG_LV_TOUCH_CONTROLLER_FT6X06=y
CONFIG_LV_I2C_TOUCH=y
CONFIG_LV_I2C_TOUCH_PORT=0
CONFIG_LV_FT6X36_SWAPXY=n
CONFIG_LV_FT6X36_INVERT_X=n
CONFIG_LV_FT6X36_INVERT_Y=n
CONFIG_LV_PREDEFINED_DISPLAY_NONE=y
CONFIG_LV_DISPLAY_ORIENTATION_PORTRAIT=y
CONFIG_LV_DISPLAY_ORIENTATION=0
CONFIG_LV_TFT_DISPLAY_SPI2_HOST=y
CONFIG_LV_TFT_DISPLAY_SPI_HALF_DUPLEX=y
CONFIG_LV_TFT_DISPLAY_SPI_TRANS_MODE_SIO=y
CONFIG_LV_DISP_BACKLIGHT_SWITCH=y
CONFIG_LV_BACKLIGHT_ACTIVE_LVL=y
CONFIG_LV_DISP_PIN_BCKL=45

# I2C Manager config for touch (I2C port 0, pins 15/16)
CONFIG_I2C_MANAGER_0_ENABLED=y
CONFIG_I2C_MANAGER_0_SDA=16
CONFIG_I2C_MANAGER_0_SCL=15
CONFIG_I2C_MANAGER_0_FREQ_HZ=400000
CONFIG_I2C_MANAGER_0_TIMEOUT=20
CONFIG_I2C_MANAGER_0_LOCK_TIMEOUT=50

# LVGL color depth
CONFIG_LV_COLOR_DEPTH_16=y
CONFIG_LV_COLOR_16_SWAP=y
```
